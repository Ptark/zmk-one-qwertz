## boards/shields/one_qwertz/Kconfig.defconfig
```kconfig
if SHIELD_ONE_QWERTZ_LEFT

config ZMK_KEYBOARD_NAME
    default "one_qwertz"

config ZMK_SPLIT_ROLE_CENTRAL
    default y

endif # SHIELD_ONE_QWERTZ_LEFT

if SHIELD_ONE_QWERTZ_LEFT || SHIELD_ONE_QWERTZ_RIGHT

config ZMK_SPLIT
    default y

endif # SHIELD_ONE_QWERTZ_LEFT || SHIELD_ONE_QWERTZ_RIGHT
```

## boards/shields/one_qwertz/Kconfig.shield
```kconfig
config SHIELD_ONE_QWERTZ_LEFT
    def_bool $(shields_list_contains,one_qwertz_left)

config SHIELD_ONE_QWERTZ_RIGHT
    def_bool $(shields_list_contains,one_qwertz_right)
```
